## CMakeLists.txt
```
cmake_minimum_required(VERSION 3.20.0)

find_package(Zephyr REQUIRED HINTS $ENV{ZEPHYR_BASE})
project(time_uart_logic_tests)

target_include_directories(app PRIVATE
	../../../src/bridge
	../../../src/time
)
target_sources(app PRIVATE
	src/test_time_uart.c
	src/test_uart_rx_recovery.c
	../../../src/bridge/byte_ring.c
	../../../src/bridge/uart_rx_recovery.c
	../../../src/time/time_uart.c
)
```

## prj.conf
```kconfig
CONFIG_ZTEST=y
CONFIG_SERIAL=y
CONFIG_UART_ASYNC_API=y
CONFIG_UART_NATIVE_PTY=y
```

## native_sim.overlay
```dts
/ {
	aliases {
		time-uart = &uart1;
	};
};

&uart1 {
	status = "okay";
};
```

## src/test_time_uart.c
```c
#include <errno.h>

#include <zephyr/drivers/uart.h>
#include <zephyr/ztest.h>

#include "time_uart.h"

static int test_rx_enable_result;
static uart_callback_t test_callback;

static int test_configure(const struct device *dev, const struct uart_config *cfg)
{
	ARG_UNUSED(dev);
	ARG_UNUSED(cfg);
	return 0;
}

static int test_callback_set(const struct device *dev, uart_callback_t callback,
			     void *user_data)
{
	ARG_UNUSED(dev);
	ARG_UNUSED(user_data);
	test_callback = callback;
	return 0;
}

static int test_rx_enable(const struct device *dev, uint8_t *buffer, size_t length,
			  int32_t timeout)
{
	ARG_UNUSED(dev);
	ARG_UNUSED(buffer);
	ARG_UNUSED(length);
	ARG_UNUSED(timeout);
	return test_rx_enable_result;
}

static const struct rb_time_uart_test_driver_ops test_driver_ops = {
	.configure = test_configure,
	.callback_set = test_callback_set,
	.rx_enable = test_rx_enable,
};

ZTEST(time_uart, test_init_failure_clears_callback_before_retry)
{
	time_uart_test_set_driver_ops(&test_driver_ops);
	test_rx_enable_result = -EBUSY;
	test_callback = NULL;
	zassert_equal(time_uart_init(9600u), -EBUSY);
	zassert_false(time_uart_test_callback_registered());
	zassert_is_null(test_callback);
	test_rx_enable_result = 0;
	zassert_equal(time_uart_init(9600u), 0);
	zassert_true(time_uart_test_callback_registered());
	zassert_not_null(test_callback);
	time_uart_test_set_driver_ops(NULL);
}

ZTEST(time_uart, test_stopped_event_with_no_rx_data_counts_reason_safely)
{
	struct uart_event event = {
		.type = UART_RX_STOPPED,
		.data.rx_stop.reason = UART_ERROR_OVERRUN,
	};
	const struct rb_time_uart_stats *stats;

	time_uart_test_inject_event(&event);
	stats = time_uart_stats_get();
	zassert_equal(stats->rx_stopped_events, 1u);
	zassert_true((stats->rx_stop_reason_mask & UART_ERROR_OVERRUN) != 0u);
	zassert_equal(stats->rx_bytes, 0u);
}

ZTEST_SUITE(time_uart, NULL, NULL, NULL, NULL, NULL);
```

## src/test_uart_rx_recovery.c
```c
#include <zephyr/sys/util.h>
#include <zephyr/ztest.h>

#include "uart_rx_recovery.h"

ZTEST(uart_rx_recovery, test_backoff_saturates_at_100_ms)
{
	static const uint32_t expected[] = {
		1u, 2u, 4u, 8u, 16u, 32u, 64u, 100u, 100u,
	};
	struct rb_uart_rx_recovery recovery;

	rb_uart_rx_recovery_init(&recovery);
	for (size_t index = 0u; index < ARRAY_SIZE(expected); index++) {
		zassert_equal(rb_uart_rx_recovery_next_delay_ms(&recovery),
			      expected[index]);
	}
}

ZTEST(uart_rx_recovery, test_valid_data_resets_backoff)
{
	struct rb_uart_rx_recovery recovery;

	rb_uart_rx_recovery_init(&recovery);
	(void)rb_uart_rx_recovery_next_delay_ms(&recovery);
	(void)rb_uart_rx_recovery_next_delay_ms(&recovery);
	rb_uart_rx_recovery_reset(&recovery);
	zassert_equal(rb_uart_rx_recovery_next_delay_ms(&recovery), 1u);
}

ZTEST(uart_rx_recovery, test_null_state_is_safe)
{
	rb_uart_rx_recovery_init(NULL);
	rb_uart_rx_recovery_reset(NULL);
	zassert_equal(rb_uart_rx_recovery_next_delay_ms(NULL), 0u);
}

ZTEST_SUITE(uart_rx_recovery, NULL, NULL, NULL, NULL, NULL);
```
