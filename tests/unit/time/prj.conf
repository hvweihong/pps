## CMakeLists.txt
```
cmake_minimum_required(VERSION 3.20.0)

find_package(Zephyr REQUIRED HINTS $ENV{ZEPHYR_BASE})
project(sync_logic_tests)

target_include_directories(app PRIVATE
	../../../src/app
	../../../src/bridge
	../../../src/time
)
target_sources(app PRIVATE
	src/test_time_sync.c
	src/test_nmea_parser.c
	src/test_utc_clock.c
	src/test_sync_tracker.c
	src/test_wireless_time_sync.c
	../../../src/time/sync_filter.c
	../../../src/time/time_sync_math.c
	../../../src/time/nmea_parser.c
	../../../src/time/utc_clock.c
	../../../src/time/sync_tracker.c
	../../../src/time/wireless_time_sync.c
)
```

## prj.conf
```kconfig
CONFIG_ZTEST=y
CONFIG_STDOUT_CONSOLE=y
```

## src/test_nmea_parser.c
```c
#include <errno.h>
#include <string.h>

#include <zephyr/ztest.h>

#include "nmea_parser.h"

ZTEST(nmea_parser, test_rmc_active_is_decoded)
{
	struct rb_nmea_utc utc;
	const char *sentence =
		"$GPRMC,123519.00,A,4807.038,N,01131.000,E,0.0,0.0,230394,,,A*5E\r\n";
	zassert_ok(rb_nmea_parse_sentence(sentence, strlen(sentence), &utc));
	zassert_equal(utc.year, 1994);
	zassert_equal(utc.month, 3);
	zassert_equal(utc.day, 23);
	zassert_equal(utc.hour, 12);
	zassert_equal(utc.minute, 35);
	zassert_equal(utc.second, 19);
	zassert_equal(utc.millisecond, 0);
}

ZTEST(nmea_parser, test_zda_is_decoded)
{
	struct rb_nmea_utc utc;
	const char *sentence = "$GPZDA,201530.00,04,07,2002,00,00*60\r\n";
	zassert_ok(rb_nmea_parse_sentence(sentence, strlen(sentence), &utc));
	zassert_equal(utc.year, 2002);
	zassert_equal(utc.month, 7);
	zassert_equal(utc.day, 4);
	zassert_equal(utc.hour, 20);
	zassert_equal(utc.minute, 15);
	zassert_equal(utc.second, 30);
	zassert_equal(utc.millisecond, 0);
}

ZTEST(nmea_parser, test_bad_checksum_and_void_rmc_are_rejected)
{
	struct rb_nmea_utc utc;
	const char *bad = "$GPRMC,123519.00,A,4807.038,N,01131.000,E,0,0,230394,,,A*00\r\n";
	const char *void_fix = "$GPRMC,123519.00,V,,,,,,,230394,,,N*7F\r\n";
	zassert_equal(rb_nmea_parse_sentence(bad, strlen(bad), &utc), -EBADMSG);
	zassert_equal(rb_nmea_parse_sentence(void_fix, strlen(void_fix), &utc), -EAGAIN);
}

ZTEST(nmea_parser, test_boundaries_fraction_leap_and_conversion)
{
	struct rb_nmea_utc utc;
	int64_t seconds;
	const char *leap = "$GPZDA,235959.999,29,02,2024,00,00*53\r\n";
	zassert_ok(rb_nmea_parse_sentence(leap, strlen(leap), &utc));
	zassert_equal(utc.millisecond, 999);
	zassert_ok(rb_nmea_utc_to_unix(&utc, &seconds));
	zassert_equal(seconds, 1709251199);

	const char *bad_date = "$GPZDA,120000,29,02,2023,00,00*41\r\n";
	zassert_equal(rb_nmea_parse_sentence(bad_date, strlen(bad_date), &utc), -ERANGE);
	const char *bad_time = "$GPZDA,246000,01,01,2024,00,00*4C\r\n";
	zassert_equal(rb_nmea_parse_sentence(bad_time, strlen(bad_time), &utc), -ERANGE);
	const char *bad_fraction = "$GPZDA,1200.00,01,01,2024,00,00*61\r\n";
	zassert_equal(rb_nmea_parse_sentence(bad_fraction, strlen(bad_fraction), &utc), -EINVAL);
}

ZTEST(nmea_parser, test_zda_requires_fixed_width_date_fields)
{
	struct rb_nmea_utc utc;
	const char *short_day = "$GPZDA,201530.00,4,07,2002,00,00*50\r\n";
	const char *short_month = "$GPZDA,201530.00,04,7,2002,00,00*50\r\n";
	const char *long_year = "$GPZDA,201530.00,04,07,02002,00,00*50\r\n";
	zassert_equal(rb_nmea_parse_sentence(short_day, strlen(short_day), &utc), -EINVAL);
	zassert_equal(rb_nmea_parse_sentence(short_month, strlen(short_month), &utc), -EINVAL);
	zassert_equal(rb_nmea_parse_sentence(long_year, strlen(long_year), &utc), -EINVAL);
}

ZTEST(nmea_parser, test_failure_does_not_mutate_utc_output)
{
	struct rb_nmea_utc utc = {1999, 9, 9, 9, 9, 9, 999};
	const struct rb_nmea_utc expected = {1999, 9, 9, 9, 9, 9, 999};
	const char *bad_date = "$GPZDA,120000,29,02,2023,00,00*41\r\n";
	zassert_equal(rb_nmea_parse_sentence(bad_date, strlen(bad_date), &utc), -ERANGE);
	zassert_mem_equal(&utc, &expected, sizeof(utc));
}

ZTEST(nmea_parser, test_missing_dollar_star_unsupported_and_overlong_rejected)
{
	struct rb_nmea_utc utc;
	const char *missing_dollar = "GPZDA,201530.00,04,07,2002,00,00*4E";
	const char *missing_star = "$GPZDA,201530.00,04,07,2002,00,00";
	const char *unsupported = "$GPTXT,01,01,02,hello*2F";
	char overlong[RB_NMEA_MAX_SENTENCE_LENGTH + 1];
	memset(overlong, 'A', sizeof(overlong));
	zassert_equal(rb_nmea_parse_sentence(missing_dollar, strlen(missing_dollar), &utc), -EINVAL);
	zassert_equal(rb_nmea_parse_sentence(missing_star, strlen(missing_star), &utc), -EBADMSG);
	zassert_equal(rb_nmea_parse_sentence(unsupported, strlen(unsupported), &utc), -ENOTSUP);
	zassert_equal(rb_nmea_parse_sentence(overlong, sizeof(overlong), &utc), -EMSGSIZE);
}

ZTEST(nmea_parser, test_epoch_and_pre_epoch_conversion)
{
	struct rb_nmea_utc utc = {1970, 1, 1, 0, 0, 0, 0};
	int64_t seconds;
	zassert_ok(rb_nmea_utc_to_unix(&utc, &seconds));
	zassert_equal(seconds, 0);
	utc.year = 1969;
	zassert_equal(rb_nmea_utc_to_unix(&utc, &seconds), -ERANGE);
}

ZTEST_SUITE(nmea_parser, NULL, NULL, NULL, NULL, NULL);
```

## src/test_sync_tracker.c
```c
#include <errno.h>
#include <stdint.h>

#include <zephyr/ztest.h>

#include "sync_tracker.h"

ZTEST(sync_tracker, test_second_frame_pairs_previous_address_capture)
{
	struct rb_sync_tracker tracker;
	struct sync_observation obs;

	rb_sync_tracker_init(&tracker);
	rb_sync_tracker_reset_session(&tracker, 0x1234);
	rb_sync_tracker_record_local(&tracker, 10, 500100);
	zassert_ok(rb_sync_tracker_pair(&tracker, 11, 10, 500000, 1000000,
					&obs));
	zassert_equal(obs.master_tick, 500000);
	zassert_equal(obs.local_tick, 500100);
	zassert_equal(obs.next_pps_master_tick, 1000000);
}

ZTEST(sync_tracker, test_first_frame_and_mismatch_wait_for_complete_pair)
{
	struct rb_sync_tracker tracker;
	struct sync_observation obs = {0};

	rb_sync_tracker_init(&tracker);
	rb_sync_tracker_reset_session(&tracker, 1);
	zassert_equal(rb_sync_tracker_pair(&tracker, 1, 0, 100, 1000, &obs),
		      -EAGAIN);
	rb_sync_tracker_record_local(&tracker, 4, 400);
	zassert_equal(rb_sync_tracker_pair(&tracker, 6, 5, 500, 1000, &obs),
		      -EAGAIN);
	zassert_true(tracker.local_valid);
	zassert_equal(tracker.local_sequence, 4);
}

ZTEST(sync_tracker, test_duplicate_pair_is_rejected)
{
	struct rb_sync_tracker tracker;
	struct sync_observation obs;

	rb_sync_tracker_init(&tracker);
	rb_sync_tracker_reset_session(&tracker, 1);
	rb_sync_tracker_record_local(&tracker, 10, 1000);
	zassert_ok(rb_sync_tracker_pair(&tracker, 11, 10, 900, 2000, &obs));
	zassert_equal(rb_sync_tracker_pair(&tracker, 11, 10, 900, 2000, &obs),
		      -EALREADY);
}

ZTEST(sync_tracker, test_session_reset_discards_old_capture)
{
	struct rb_sync_tracker tracker;
	struct sync_observation obs;

	rb_sync_tracker_init(&tracker);
	rb_sync_tracker_reset_session(&tracker, 1);
	rb_sync_tracker_record_local(&tracker, 10, 1000);
	rb_sync_tracker_reset_session(&tracker, 2);
	zassert_equal(rb_sync_tracker_pair(&tracker, 11, 10, 900, 2000, &obs),
		      -EAGAIN);
	zassert_false(tracker.local_valid);
}

ZTEST(sync_tracker, test_sync_sequence_wrap_pairs_normally)
{
	struct rb_sync_tracker tracker;
	struct sync_observation obs;

	rb_sync_tracker_init(&tracker);
	rb_sync_tracker_reset_session(&tracker, 1);
	rb_sync_tracker_record_local(&tracker, UINT32_MAX, 1000);
	zassert_ok(rb_sync_tracker_pair(&tracker, 0, UINT32_MAX, 900, 2000, &obs));
	zassert_equal(obs.local_tick, 1000);
}

ZTEST_SUITE(sync_tracker, NULL, NULL, NULL, NULL, NULL);
```

## src/test_time_sync.c
```c
#include <zephyr/ztest.h>

#include "sync_filter.h"
#include "heartbeat_led.h"
#include "time_sync_math.h"

ZTEST(sync_filter, test_filter_locks_after_consecutive_valid_beacons)
{
	struct sync_filter filter;
	struct sync_filter_config cfg = sync_filter_default_config();
	struct sync_observation obs = {
		.master_tick = 100000,
		.local_tick = 100500,
		.next_pps_master_tick = 1000000,
	};

	sync_filter_init(&filter, &cfg);

	for (int i = 0; i < cfg.lock_beacons - 1; i++) {
		obs.master_tick += cfg.sync_interval_us;
		obs.local_tick += cfg.sync_interval_us;
		sync_filter_update(&filter, &obs);
		zassert_not_equal(sync_filter_state(&filter), SYNC_FILTER_LOCKED);
	}

	obs.master_tick += cfg.sync_interval_us;
	obs.local_tick += cfg.sync_interval_us;
	sync_filter_update(&filter, &obs);

	zassert_equal(sync_filter_state(&filter), SYNC_FILTER_LOCKED);
	zassert_within(sync_filter_offset_us(&filter), -500, 1);
}

ZTEST(sync_filter, test_filter_rejects_locked_outlier)
{
	struct sync_filter filter;
	struct sync_filter_config cfg = sync_filter_default_config();
	struct sync_observation obs = {
		.master_tick = 100000,
		.local_tick = 100500,
		.next_pps_master_tick = 1000000,
	};

	sync_filter_init(&filter, &cfg);

	for (int i = 0; i < cfg.lock_beacons; i++) {
		obs.master_tick += cfg.sync_interval_us;
		obs.local_tick += cfg.sync_interval_us;
		sync_filter_update(&filter, &obs);
	}

	int64_t before = sync_filter_offset_us(&filter);
	obs.master_tick += cfg.sync_interval_us;
	obs.local_tick += cfg.sync_interval_us + cfg.outlier_threshold_us + 1000;
	zassert_equal(sync_filter_update(&filter, &obs), -ERANGE);
	zassert_equal(sync_filter_offset_us(&filter), before);
}

ZTEST(sync_filter, test_filter_rejects_master_tick_after_next_pps)
{
	struct sync_filter filter;
	struct sync_filter_config cfg = sync_filter_default_config();
	struct sync_observation obs = {
		.master_tick = 3650868124415ULL,
		.local_tick = 1294860,
		.next_pps_master_tick = 147000000,
	};

	sync_filter_init(&filter, &cfg);

	zassert_equal(sync_filter_update(&filter, &obs), -ERANGE);
	zassert_equal(sync_filter_state(&filter), SYNC_FILTER_UNLOCKED);
}

ZTEST(sync_filter, test_filter_computes_negative_offset_without_underflow)
{
	struct sync_filter filter;
	struct sync_filter_config cfg = sync_filter_default_config();
	struct sync_observation obs = {
		.master_tick = 1000000,
		.local_tick = 1000500,
		.next_pps_master_tick = 2000000,
	};

	sync_filter_init(&filter, &cfg);

	zassert_equal(sync_filter_update(&filter, &obs), 0);
	zassert_equal(sync_filter_offset_us(&filter), -500);
}

ZTEST(sync_filter, test_filter_enters_holdover_and_unlocks)
{
	struct sync_filter filter;
	struct sync_filter_config cfg = sync_filter_default_config();
	struct sync_observation obs = {
		.master_tick = 100000,
		.local_tick = 100500,
		.next_pps_master_tick = 1000000,
	};

	sync_filter_init(&filter, &cfg);

	for (int i = 0; i < cfg.lock_beacons; i++) {
		obs.master_tick += cfg.sync_interval_us;
		obs.local_tick += cfg.sync_interval_us;
		sync_filter_update(&filter, &obs);
	}

	zassert_equal(sync_filter_state(&filter), SYNC_FILTER_LOCKED);
	sync_filter_note_missed(&filter, cfg.missed_holdover);
	zassert_equal(sync_filter_state(&filter), SYNC_FILTER_HOLDOVER);
	sync_filter_age(&filter, cfg.unlock_timeout_us + 1);
	zassert_equal(sync_filter_state(&filter), SYNC_FILTER_UNLOCKED);
}

ZTEST(sync_filter, test_filter_converts_master_pps_to_local_tick)
{
	struct sync_filter filter;
	struct sync_filter_config cfg = sync_filter_default_config();
	struct sync_observation obs = {
		.master_tick = 100000,
		.local_tick = 100500,
		.next_pps_master_tick = 1000000,
	};
	uint64_t local_pps;

	sync_filter_init(&filter, &cfg);

	for (int i = 0; i < cfg.lock_beacons; i++) {
		obs.master_tick += cfg.sync_interval_us;
		obs.local_tick += cfg.sync_interval_us;
		sync_filter_update(&filter, &obs);
	}

	zassert_equal(sync_filter_master_to_local(&filter, 1000000, &local_pps), 0);
	zassert_equal(local_pps, 1000500);
}

ZTEST(sync_filter, test_filter_master_to_local_predicts_drift_at_next_pps)
{
	struct sync_filter filter;
	struct sync_filter_config cfg = sync_filter_default_config();
	struct sync_observation obs = {
		.master_tick = 1000000,
		.local_tick = 1000000,
		.next_pps_master_tick = 2000000,
	};
	uint64_t local_pps;

	cfg.lock_beacons = 1;
	sync_filter_init(&filter, &cfg);
	zassert_ok(sync_filter_update(&filter, &obs));
	/* Master advances 100 us more than local over a 1 s interval. */
	obs.master_tick = 2000100;
	obs.local_tick = 2000000;
	obs.next_pps_master_tick = 3000100;
	zassert_ok(sync_filter_update(&filter, &obs));
	zassert_ok(sync_filter_master_to_local(&filter, 3000100, &local_pps));
	zassert_equal(local_pps, 2999900);
}

ZTEST(sync_filter, test_filter_reset_preserves_config_and_clears_lock)
{
	struct sync_filter filter;
	struct sync_filter_config cfg = sync_filter_default_config();
	struct sync_observation obs = {
		.master_tick = 100000,
		.local_tick = 100500,
		.next_pps_master_tick = 1000000,
	};
	uint64_t local_pps;

	cfg.lock_beacons = 2;
	cfg.outlier_threshold_us = 321;
	sync_filter_init(&filter, &cfg);
	for (int i = 0; i < cfg.lock_beacons; i++) {
		obs.master_tick += cfg.sync_interval_us;
		obs.local_tick += cfg.sync_interval_us;
		zassert_ok(sync_filter_update(&filter, &obs));
	}
	zassert_equal(sync_filter_state(&filter), SYNC_FILTER_LOCKED);

	sync_filter_reset(&filter);

	zassert_equal(sync_filter_state(&filter), SYNC_FILTER_UNLOCKED);
	zassert_equal(sync_filter_offset_us(&filter), 0);
	zassert_equal(sync_filter_drift_ppm(&filter), 0);
	zassert_equal(filter.cfg.lock_beacons, 2);
	zassert_equal(filter.cfg.outlier_threshold_us, 321);
	zassert_equal(sync_filter_master_to_local(&filter, 1000000, &local_pps),
		      -EAGAIN);
}

ZTEST(heartbeat_led, test_default_heartbeat_period_is_one_second)
{
	zassert_equal(HEARTBEAT_LED_DEFAULT_PERIOD_MS, 1000);
}

ZTEST(time_sync_math, test_next_period_tick_uses_next_boundary)
{
	zassert_equal(time_sync_next_period_tick(0, 1000000), 1000000);
	zassert_equal(time_sync_next_period_tick(1, 1000000), 1000000);
	zassert_equal(time_sync_next_period_tick(999999, 1000000), 1000000);
	zassert_equal(time_sync_next_period_tick(1000000, 1000000), 2000000);
}

ZTEST(time_sync_math, test_next_epoch_tick_after_keeps_periodic_phase)
{
	zassert_equal(time_sync_next_epoch_tick_after(1000000, 1000000, 1),
		      1000000);
	zassert_equal(time_sync_next_epoch_tick_after(1000000, 1000000, 1000000),
		      2000000);
	zassert_equal(time_sync_next_epoch_tick_after(1000000, 1000000, 3500000),
		      4000000);
	zassert_equal(time_sync_next_epoch_tick_after(1000100, 1000000, 3500000),
		      4000100);
}

ZTEST(time_sync_math, test_select_pps_target_keeps_pending_edge_when_close)
{
	uint64_t target = time_sync_select_pps_target(1000000, 1000000,
						     999500, 20000,
						     1000000, 1000);

	zassert_equal(target, 1000000);
}

ZTEST(time_sync_math, test_select_pps_target_advances_unscheduled_late_edge)
{
	uint64_t target = time_sync_select_pps_target(1000000, 1000000,
						     999500, 20000, 0,
						     1000);

	zassert_equal(target, 2000000);
}

ZTEST_SUITE(sync_filter, NULL, NULL, NULL, NULL, NULL);
ZTEST_SUITE(heartbeat_led, NULL, NULL, NULL, NULL, NULL);
ZTEST_SUITE(time_sync_math, NULL, NULL, NULL, NULL, NULL);
```

## src/test_utc_clock.c
```c
#include <errno.h>
#include <limits.h>

#include <zephyr/ztest.h>

#include "utc_clock.h"

static uint64_t reset_tick;
static int reset_count;
static int reset_result;

static int phase_reset(void *context, uint64_t target_tick)
{
	(void)context;
	reset_tick = target_tick;
	reset_count++;
	return reset_result;
}

static void setup_clock(struct rb_utc_clock *clock)
{
	struct rb_utc_clock_config config = {
		.external_mode = true,
		.loss_timeout_us = 3000000,
		.phase_reset = phase_reset,
	};
	reset_tick = 0;
	reset_count = 0;
	reset_result = 0;
	rb_utc_clock_init(clock, &config);
}

static void add_pair(struct rb_utc_clock *clock, uint64_t tick, int64_t second)
{
	rb_utc_clock_tick(clock, tick);
	zassert_ok(rb_utc_clock_note_pair(clock, tick, second));
}

static void lock_clock(struct rb_utc_clock *clock)
{
	add_pair(clock, 1000000, 100);
	add_pair(clock, 2000000, 101);
	add_pair(clock, 3000000, 102);
	zassert_equal(rb_utc_clock_state(clock), RB_UTC_LOCKED);
}

ZTEST(utc_clock, test_local_mode_is_utc_invalid)
{
	struct rb_utc_clock clock;
	struct rb_utc_clock_config config = {.external_mode = false, .loss_timeout_us = 3000000};
	struct rb_utc_publication publication;
	rb_utc_clock_init(&clock, &config);
	zassert_equal(rb_utc_clock_state(&clock), RB_UTC_LOCAL);
	zassert_ok(rb_utc_clock_publication(&clock, 0, &publication));
	zassert_false(publication.valid);
	zassert_equal(publication.quality, RB_TIME_UTC_INVALID);
	zassert_equal(rb_utc_clock_note_pair(&clock, 1000000, 100), -EACCES);
}

ZTEST(utc_clock, test_external_cold_boot_is_acquiring_but_utc_invalid)
{
	struct rb_utc_clock clock;
	struct rb_utc_publication publication;
	setup_clock(&clock);
	zassert_equal(rb_utc_clock_state(&clock), RB_UTC_ACQUIRING);
	zassert_ok(rb_utc_clock_publication(&clock, 0, &publication));
	zassert_false(publication.valid);
	zassert_equal(publication.quality, RB_TIME_UTC_INVALID);
}

ZTEST(utc_clock, test_first_external_pair_hard_realigns)
{
	struct rb_utc_clock clock;
	setup_clock(&clock);
	add_pair(&clock, 1000000, 100);
	zassert_equal(rb_utc_clock_state(&clock), RB_UTC_ACQUIRING);
	zassert_equal(reset_count, 1);
	zassert_equal(reset_tick, 2000000);
}

ZTEST(utc_clock, test_three_pairs_enter_locked)
{
	struct rb_utc_clock clock;
	struct rb_utc_publication publication;
	setup_clock(&clock);
	add_pair(&clock, 1000000, 100);
	add_pair(&clock, 2000000, 101);
	zassert_equal(rb_utc_clock_state(&clock), RB_UTC_ACQUIRING);
	add_pair(&clock, 3000000, 102);
	zassert_equal(rb_utc_clock_state(&clock), RB_UTC_LOCKED);
	zassert_ok(rb_utc_clock_publication(&clock, 3000000, &publication));
	zassert_true(publication.valid);
	zassert_equal(publication.quality, RB_TIME_LOCKED);
	zassert_equal(publication.next_pps_utc_seconds, 103);
}

ZTEST(utc_clock, test_utc_second_gap_restarts_acquisition)
{
	struct rb_utc_clock clock;
	setup_clock(&clock);
	add_pair(&clock, 1000000, 100);
	rb_utc_clock_tick(&clock, 2000000);
	zassert_ok(rb_utc_clock_note_pair(&clock, 2000000, 102));
	zassert_equal(rb_utc_clock_state(&clock), RB_UTC_ACQUIRING);
	zassert_equal(clock.valid_pairs, 1);
	zassert_equal(reset_count, 2);
}

ZTEST(utc_clock, test_discontinuous_pair_restarts_acquisition)
{
	struct rb_utc_clock clock;
	setup_clock(&clock);
	add_pair(&clock, 1000000, 100);
	add_pair(&clock, 3000000, 102);
	zassert_equal(rb_utc_clock_state(&clock), RB_UTC_ACQUIRING);
	zassert_equal(reset_count, 2);
	add_pair(&clock, 4000000, 103);
	zassert_equal(rb_utc_clock_state(&clock), RB_UTC_ACQUIRING);
	add_pair(&clock, 5000000, 104);
	zassert_equal(rb_utc_clock_state(&clock), RB_UTC_LOCKED);
}

ZTEST(utc_clock, test_failed_discontinuous_reset_preserves_old_baseline)
{
	struct rb_utc_clock clock;
	setup_clock(&clock);
	add_pair(&clock, 1000000, 100);
	reset_result = -EIO;
	rb_utc_clock_tick(&clock, 3000000);
	zassert_equal(rb_utc_clock_note_pair(&clock, 3000000, 102), -EIO);
	zassert_equal(clock.last_pair_tick, 1000000);
	zassert_equal(clock.last_pair_second, 100);
	zassert_equal(clock.valid_pairs, 1);
	reset_result = 0;
	add_pair(&clock, 4000000, 103);
	add_pair(&clock, 5000000, 104);
	add_pair(&clock, 6000000, 105);
	zassert_equal(rb_utc_clock_state(&clock), RB_UTC_LOCKED);
}

ZTEST(utc_clock, test_phase_reset_failure_does_not_accept_pair)
{
	struct rb_utc_clock clock;
	setup_clock(&clock);
	reset_result = -EIO;
	rb_utc_clock_tick(&clock, 1000000);
	zassert_equal(rb_utc_clock_note_pair(&clock, 1000000, 100), -EIO);
	zassert_equal(reset_count, 1);
	zassert_equal(rb_utc_clock_state(&clock), RB_UTC_ACQUIRING);
	zassert_equal(rb_utc_clock_note_pair(&clock, 1000000, 100), -EIO);
}

ZTEST(utc_clock, test_missing_pps_or_nmea_for_three_seconds_enters_holdover)
{
	struct rb_utc_clock clock;
	setup_clock(&clock);
	lock_clock(&clock);
	rb_utc_clock_tick(&clock, 6000000);
	zassert_equal(rb_utc_clock_state(&clock), RB_UTC_HOLDOVER);
}

ZTEST(utc_clock, test_holdover_increments_last_utc)
{
	struct rb_utc_clock clock;
	struct rb_utc_publication publication;
	setup_clock(&clock);
	lock_clock(&clock);
	rb_utc_clock_tick(&clock, 6000000);
	zassert_ok(rb_utc_clock_publication(&clock, 6000000, &publication));
	zassert_true(publication.valid);
	zassert_equal(publication.quality, RB_TIME_HOLDOVER);
	zassert_equal(publication.next_pps_utc_seconds, 106);
}

ZTEST(utc_clock, test_publication_projects_to_its_now_tick)
{
	struct rb_utc_clock clock;
	struct rb_utc_publication publication;
	setup_clock(&clock);
	lock_clock(&clock);
	zassert_ok(rb_utc_clock_publication(&clock, 4000000, &publication));
	zassert_true(publication.valid);
	zassert_equal(publication.quality, RB_TIME_LOCKED);
	zassert_equal(publication.next_pps_utc_seconds, 104);
	zassert_equal(rb_utc_clock_state(&clock), RB_UTC_LOCKED);
}

ZTEST(utc_clock, test_recovery_skips_edge_under_500ms)
{
	struct rb_utc_clock clock;
	struct rb_utc_publication publication;
	setup_clock(&clock);
	lock_clock(&clock);
	rb_utc_clock_tick(&clock, 6000000);
	zassert_equal(rb_utc_clock_note_pair(&clock, 5100000, 104), 0);
	zassert_equal(rb_utc_clock_state(&clock), RB_UTC_ACQUIRING);
	zassert_equal(reset_tick, 7100000);
	zassert_ok(rb_utc_clock_publication(&clock, 6000000, &publication));
	zassert_equal(publication.next_pps_utc_seconds, 106);
}

ZTEST(utc_clock, test_pair_after_900ms_is_rejected)
{
	struct rb_utc_clock clock;
	setup_clock(&clock);
	rb_utc_clock_tick(&clock, 1000001);
	zassert_equal(rb_utc_clock_note_pair(&clock, 100000, 100), -ERANGE);
	rb_utc_clock_tick(&clock, 1000000);
	zassert_equal(rb_utc_clock_note_pair(&clock, 1000000, 100), 0);
}

ZTEST(utc_clock, test_overflowing_pair_is_rejected_without_state_change)
{
	struct rb_utc_clock clock;
	setup_clock(&clock);
	rb_utc_clock_tick(&clock, UINT64_MAX);
	zassert_equal(rb_utc_clock_note_pair(&clock, UINT64_MAX - 1, 100), -ERANGE);
	zassert_false(clock.have_pair);
	rb_utc_clock_tick(&clock, 1000000);
	zassert_equal(rb_utc_clock_note_pair(&clock, 1000000, INT64_MAX), -ERANGE);
	zassert_false(clock.have_pair);
}

ZTEST(utc_clock, test_backward_ticks_do_not_regress_clock_or_publication)
{
	struct rb_utc_clock clock;
	struct rb_utc_publication publication;
	setup_clock(&clock);
	rb_utc_clock_tick(&clock, 2000000);
	rb_utc_clock_tick(&clock, 1000000);
	zassert_equal(clock.now_tick, 2000000);
	zassert_equal(rb_utc_clock_publication(&clock, 1999999, &publication), -ERANGE);
}

ZTEST_SUITE(utc_clock, NULL, NULL, NULL, NULL, NULL);
```

## src/test_wireless_time_sync.c
```c
#include <zephyr/ztest.h>

#include "wireless_time_sync.h"

ZTEST(wireless_time_sync, test_master_first_frame_has_no_previous_capture)
{
	struct rb_wireless_time_sync sync;
	struct rb_sync_frame frame;

	wireless_time_sync_init(&sync, 7, 100000, 1000000, 0);
	zassert_ok(wireless_time_sync_master_build(&sync, 1000000, &frame));
	zassert_equal(frame.sync_sequence, 1);
	zassert_equal(frame.previous_master_address_tick, 0);

	wireless_time_sync_master_tx_captured(&sync, 1, 1234);
	zassert_ok(wireless_time_sync_master_build(&sync, 1100000, &frame));
	zassert_equal(frame.previous_master_address_tick, 1234);
}

ZTEST(wireless_time_sync, test_slave_pairs_two_consecutive_sync_frames)
{
	struct rb_wireless_time_sync sync;
	struct rb_sync_frame first;
	struct rb_sync_frame second;
	struct sync_observation observation;

	wireless_time_sync_init(&sync, 0, 100000, 0, 17);
	first.common = RB_COMMON_INIT(RB_FRAME_SYNC, 9, 0);
	first.sync_sequence = 1;
	first.next_pps_master_tick = 1000000;
	second = first;
	second.sync_sequence = 2;
	second.previous_master_address_tick = 5000;
	zassert_equal(wireless_time_sync_slave_receive(&sync, &first, 7000,
							NULL), -EINVAL);
	zassert_equal(wireless_time_sync_slave_receive(&sync, &first, 7000,
							&observation), -EAGAIN);
	zassert_ok(wireless_time_sync_slave_receive(&sync, &second, 8000,
						    &observation));
	zassert_equal(observation.local_tick, 7000);
	zassert_equal(observation.master_tick, 5017);
}

ZTEST_SUITE(wireless_time_sync, NULL, NULL, NULL, NULL, NULL);
```
